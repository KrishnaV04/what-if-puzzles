#include <SPI.h>
#include <Wire.h>
#include <Adafruit_GFX.h>
#include <Adafruit_SSD1306.h>


// image help from https://javl.github.io/image2cpp/

#define OLED_RESET 4
Adafruit_SSD1306 display(OLED_RESET);

const unsigned char box [] PROGMEM = {
  0xff, 0xff, 0xf0, 0x80, 0x00, 0x10, 0x80, 0x00, 0x10, 0x80, 0x00, 0x10, 0x80, 0x00, 0x10, 0x80, 
  0x00, 0x10, 0x80, 0x00, 0x10, 0x80, 0x00, 0x10, 0x80, 0x00, 0x10, 0xff, 0xff, 0xf0
};

const unsigned char boardp10 [] PROGMEM = {
  0xff, 0xff, 0xf0, 0xb8, 0x01, 0xd0, 0x8e, 0x07, 0x10, 0x83, 0x9c, 0x10, 0x81, 0xf0, 0x10, 0x81, 
  0xf8, 0x10, 0x87, 0x1e, 0x10, 0x9c, 0x07, 0x10, 0xf0, 0x01, 0xf0, 0xff, 0xff, 0xf0
};

const unsigned char boardp9 [] PROGMEM = {
  0xe0, 0x00, 0x00, 0x80, 0x00, 0x00, 0x00, 0x00, 0x00, 0x00, 0x00, 0x00, 0x00, 0x00, 0x00, 0x00, 
  0x00, 0x00, 0x00, 0x00, 0x00, 0x00, 0x00, 0x00, 0x00, 0x00, 0x00, 0x00, 0x00, 0x00
};

const unsigned char boardp8 [] PROGMEM = {
  0xff, 0xff, 0xf0, 0xff, 0xff, 0xf0, 0xff, 0xff, 0xf0, 0xff, 0xff, 0xf0, 0x7f, 0xff, 0xc0, 0x1f, 
  0xff, 0x80, 0x0f, 0xfe, 0x00, 0x03, 0xfc, 0x00, 0x01, 0xf0, 0x00, 0x00, 0x40, 0x00
};

const unsigned char boardp7 [] PROGMEM = {
  0x00, 0x00, 0x70, 0x00, 0x00, 0x10, 0x00, 0x00, 0x00, 0x00, 0x00, 0x00, 0x00, 0x00, 0x00, 0x00, 
  0x00, 0x00, 0x00, 0x00, 0x00, 0x00, 0x00, 0x00, 0x00, 0x00, 0x00, 0x00, 0x00, 0x00
};

const unsigned char boardp6 [] PROGMEM = {
  0xff, 0xff, 0xf0, 0xff, 0xff, 0xc0, 0xff, 0xff, 0x00, 0xff, 0xfc, 0x00, 0xff, 0xf8, 0x00, 0xff, 
  0xe0, 0x00, 0xff, 0xc0, 0x00, 0xff, 0x00, 0x00, 0xfe, 0x00, 0x00, 0xfc, 0x00, 0x00
};

const unsigned char boardp5 [] PROGMEM = {
  0xff, 0xff, 0xf0, 0xff, 0xff, 0xf0, 0xff, 0xff, 0xf0, 0xff, 0xff, 0xf0, 0xff, 0xff, 0xf0, 0xff, 
  0xff, 0xf0, 0xff, 0xff, 0xf0, 0xff, 0xff, 0xf0, 0xff, 0xff, 0xf0, 0xff, 0xff, 0xf0
};

const unsigned char boardp4 [] PROGMEM = {
  0xff, 0xff, 0xf0, 0x3f, 0xff, 0xf0, 0x0f, 0xff, 0xf0, 0x03, 0xff, 0xf0, 0x01, 0xff, 0xf0, 0x00, 
  0x7f, 0xf0, 0x00, 0x3f, 0xf0, 0x00, 0x0f, 0xf0, 0x00, 0x07, 0xf0, 0x00, 0x03, 0xf0
};

const unsigned char boardp3 [] PROGMEM = {
 0x00, 0x00, 0x00, 0x00, 0x00, 0x00, 0x00, 0x00, 0x00, 0x00, 0x00, 0x00, 0x00, 0x00, 0x00, 0xfc, 
 0x00, 0x00, 0xff, 0x80, 0x00, 0xff, 0xf0, 0x00, 0xff, 0xfe, 0x00, 0xff, 0xff, 0xe0
};

const unsigned char boardp2 [] PROGMEM = {
  0x00, 0x00, 0x00, 0x00, 0x00, 0x00, 0x00, 0x00, 0x00, 0x00, 0x00, 0x00, 0x00, 0x00, 0x00, 0xff, 
  0xff, 0xf0, 0xff, 0xff, 0xf0, 0xff, 0xff, 0xf0, 0xff, 0xff, 0xf0, 0xff, 0xff, 0xf0
};

const unsigned char boardp1 [] PROGMEM= {
 0x00, 0x00, 0x00, 0x00, 0x00, 0x00, 0x00, 0x00, 0x00, 0x00, 0x00, 0x00, 0x00, 0x00, 0x00, 0x00, 
 0x03, 0xf0, 0x00, 0x1f, 0xf0, 0x00, 0xff, 0xf0, 0x07, 0xff, 0xf0, 0x7f, 0xff, 0xf0
};

const unsigned char puzzle [] PROGMEM = {
  0x00, 0x00, 0x00, 0x00, 0x00, 0x00, 0x00, 0x00, 0x00, 0x00, 0x00, 0x00, 0x00, 0x00, 0x00, 0x00, 
  0x00, 0x00, 0x00, 0x00, 0x00, 0x00, 0x00, 0x00, 0x00, 0x00, 0x00, 0x00, 0x00, 0x00, 0x00, 0x00, 
  0x00, 0x07, 0x00, 0x00, 0x00, 0x00, 0x00, 0x00, 0x00, 0x00, 0x00, 0x00, 0x00, 0x00, 0x00, 0x00, 
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  0x00, 0x00, 0x00, 0x00, 0x00, 0x00, 0x00, 0x00, 0x00, 0x00, 0x00, 0x00, 0x00, 0x00, 0x00, 0x00
};

const int buttonPin = 6;
const int ledPin = 4;
const int buzzerPin = 5;
int buttonState = 0;
int emptyindex = 9;

//const int board_array = 10;

const unsigned char* board[10] = {
    boardp1, boardp2, boardp3, boardp4, boardp5, boardp6, boardp7, boardp8, boardp9, boardp10
};

int ustorage[] = {0,1,2,3,4,5,6,7,8,9};

void setup() {
  // put your setup code here, to run once:
  
  Serial.begin(9600);
  pinMode(buzzerPin, OUTPUT);
  pinMode(buttonPin, INPUT);
  pinMode(ledPin, OUTPUT);

  for (int a=0; a<10; a++){ //randomness creator
    int r = random(a,9); // dont remember syntax just now, random from a to 8 included.
    int temp = ustorage[a];
    ustorage[a] = ustorage[r];
    ustorage[r] = temp;
  }
  
  display.begin(SSD1306_SWITCHCAPVCC, 0x3c);
  display.clearDisplay();
  digitalWrite(ledPin, LOW); //for some reason it starts from HIGH
  display.display();
  display.setRotation(2); //for some reason is upside down
  display.setTextSize(1);
  display.setTextColor(WHITE);
  display.setCursor(0,8);
  fancyText(0, "   What If?\n   PUZZLES!");
  display.drawBitmap(80, 0, puzzle, 128, 32, WHITE);
  display.display();
  delay(3000);
  display.clearDisplay();
  display.setCursor(0,0);
  fancyText(0, "What if you can solvethis puzzle?"); //formated for output
  fancyText(0, " To play use the button and\nrotary potentiometer."); //formated for output
  delay(1000);
  display.display();
  display.clearDisplay();
  display.display();


  display.setTextSize(1);
  display.setTextColor(WHITE);
  
}

void loop() {
  //display.clearDisplay();

   displayBoard(ustorage);
   
    
  if(winnable()){
    delay(2500);
    while(1==1){
      digitalWrite(ledPin, HIGH);
      digitalWrite(buzzerPin, HIGH);
      delay(100);
      digitalWrite(buzzerPin, LOW);
      display.clearDisplay(); 
      display.display();
      display.setCursor(15,10);
      display.setTextSize(2);
      fancyText(0, "YOU WON!");
      
    }
  }
  int sensorvalue;
  while(digitalRead(buttonPin) == LOW){ //loop for waiting for an input
    sensorvalue = analogRead(A0);
    display.setCursor(97,7);
    display.display();
    delay(10);
    display.clearDisplay();
    display.println(sensorvalue / 113);
    displayBoard(ustorage);
  }
  
  int switchnum = sensorvalue / 113;
  
  if(switchable(switchnum, index(ustorage,9))){
    ustorage[index(ustorage,9)] = ustorage[switchnum];
    ustorage[switchnum] = emptyindex;
  }
} //end of loop

boolean switchable(int x, int y){ //need to implement a system to show negative feedback
  if((x == 9 || y == 9) && (x == 6 || y == 6)) {return false;}
  if((x == 2 || y == 2) && (x == 3 || y == 3)) {return false;}
  if((x == 5 || y == 5) && (x == 6 || y == 6)) {return false;}
  if(abs(x-y) == 0) { return false;} //the same thing
  if(abs(x-y) == 1) { return true;} //next to each other
  if(abs(x-y) == 3) {return true;} //above or below
  return false;
}


boolean winnable(){
  for(int x = 0; x < 10; x++){
    if(ustorage[x] != x){
      return false;
    }
  }
  return true;
}


int index(int arr[], int num){
  for(int x = 0; x < 10; x++){
    if(arr[x] == num){
      return x;
    }
  }
  return -1;
}


void displayBoard(int ustorage[]) {
  display.drawBitmap(00, 0, box, 20, 10, WHITE); //tile 1
  display.drawBitmap(22, 0, box, 20, 10, WHITE); //tile 2
  display.drawBitmap(44, 0, box, 20, 10, WHITE); //tile 3
  display.drawBitmap(00, 11, box, 20, 10, WHITE); //tile 4
  display.drawBitmap(22, 11, box, 20, 10, WHITE);// tile 5
  display.drawBitmap(44, 11, box, 20, 10, WHITE); //tile 6
  display.drawBitmap(00, 22, box, 20, 10, WHITE); //tile 7
  display.drawBitmap(22, 22, box, 20, 10, WHITE); //tile 8
  display.drawBitmap(44, 22, box, 20, 10, WHITE); // tile 9
  display.drawBitmap(64, 22, box, 20, 10, WHITE); // tile 10
  
  display.drawBitmap(00, 00, board[ustorage[0]], 20, 10, WHITE); //tile 1
  display.drawBitmap(22, 00, board[ustorage[1]], 20, 10, WHITE); //tile 2
  display.drawBitmap(44, 00, board[ustorage[2]], 20, 10, WHITE); //tile 3
  display.drawBitmap(00, 11, board[ustorage[3]], 20, 10, WHITE); //tile 4
  display.drawBitmap(22, 11, board[ustorage[4]], 20, 10, WHITE);// tile 5
  display.drawBitmap(44, 11, board[ustorage[5]], 20, 10, WHITE); //tile 6
  display.drawBitmap(00, 22, board[ustorage[6]], 20, 10, WHITE); //tile 7
  display.drawBitmap(22, 22, board[ustorage[7]], 20, 10, WHITE); //tile 8
  display.drawBitmap(44, 22, board[ustorage[8]], 20, 10, WHITE); // tile 9
  display.drawBitmap(64, 22, board[ustorage[9]], 20, 10, WHITE); // tile 10
  display.drawBitmap(90, 6, box, 20, 10, WHITE); // box
  
  display.display();
}


void fancyText(int ms, String input) {
  for(int x = 0; x < input.length(); x++){
    display.print(input.charAt(x));
    delay(ms);
    display.display();
  }
}
